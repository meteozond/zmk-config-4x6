/*
 * Copyright (c) 2022 Lau Kar Rui
 *
 * SPDX-License-Identifier: MIT
 */

#include "cnano.dtsi"

&default_transform {
    col-offset = <5>;
};

&kscan0 {
    col-gpios
        = <&pro_micro  8 (GPIO_ACTIVE_HIGH | GPIO_PULL_DOWN)>
        , <&pro_micro  7 (GPIO_ACTIVE_HIGH | GPIO_PULL_DOWN)>
        , <&pro_micro  6 (GPIO_ACTIVE_HIGH | GPIO_PULL_DOWN)>
        , <&pro_micro 10 (GPIO_ACTIVE_HIGH | GPIO_PULL_DOWN)>
        , <&pro_micro 20 (GPIO_ACTIVE_HIGH | GPIO_PULL_DOWN)>
        ;
};

// trackball bus
&spi0 {
    status = "okay"; //okay
    sck-pin = <13>;
    mosi-pin = <11>;
    miso-pin = <20>;
    cs-gpios = <&gpio1 2 GPIO_ACTIVE_LOW>;
};

&trackball {
    status = "okay"; //okay
    irq-gpios = <&gpio0 6 (GPIO_ACTIVE_LOW | GPIO_PULL_UP)>;
};